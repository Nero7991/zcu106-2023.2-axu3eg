## project-spec/configs/rootfsconfigs/Kconfig.user
```kconfig
menu "user packages " 
config gpio-demo  
	 bool "gpio-demo"
	 help
	
config gstreamer-vcu-examples  
	 bool "gstreamer-vcu-examples"
	 help
	
config gstreamer-vcu-notebooks  
	 bool "gstreamer-vcu-notebooks"
	 help
	
config packagegroup-petalinux-audio  
	 bool "packagegroup-petalinux-audio"
	 help
	
config packagegroup-petalinux-v4lutils  
	 bool "packagegroup-petalinux-v4lutils"
	 help
	
config peekpoke  
	 bool "peekpoke"
	 help
	
config simple-gpio-fan  
	 bool "simple-gpio-fan"
	 help
	
config soft-pwm-fan  
	 bool "soft-pwm-fan"
	 help
	
config zynqmp-pssysmon-temp  
	 bool "zynqmp-pssysmon-temp"
	 help
	
endmenu
```
